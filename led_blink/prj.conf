## CMakeLists.txt
```
cmake_minimum_required(VERSION 3.22)
set(BOARD rpi_pico)

find_package(Zephyr)
project(Dhruv_01)

target_sources(app PRIVATE src/main.c) 
```

## prj.conf
```kconfig
CONFIG_PWM=y
CONFIG_I2C=y
CONFIG_DISPLAY=y
CONFIG_SSD1306=y 
CONFIG_GPIO=y
```

## rpi_pico.overlay
```dts
 &uart0 {
	current-speed = <115200>;
	status = "okay";
	pinctrl-0 = <&uart0_default>;
	pinctrl-names = "default";
};

&gpio0 {
	status = "okay";
};

&i2c0 {
	clock-frequency = <I2C_BITRATE_STANDARD>;
	status = "okay";
	pinctrl-0 = <&i2c0_default>;
	pinctrl-names = "default";
};
```

## src/main.c
```c
#include <zephyr/kernel.h>
#include <zephyr/device.h>
#include <zephyr/drivers/gpio.h>

static const struct device *gpio_ct_dev = DEVICE_DT_GET(DT_NODELABEL(gpio0));

void main(void){
	if (!device_is_ready(gpio_ct_dev)){
	return;
	}
	int ret;
	ret = gpio_pin_configure(gpio_ct_dev,25,GPIO_OUTPUT_ACTIVE);
	
	if (ret !=0 ) {
		return;
	}
	
	while (true) {
		ret =gpio_pin_set_raw(gpio_ct_dev,25,1);
		if (ret != 0) {
			return;
		}
		k_msleep(100);
		
		ret =gpio_pin_set_raw(gpio_ct_dev,25,0);
		if (ret != 0) {
			return;
		}
		k_msleep(100);
	}
} 
```
